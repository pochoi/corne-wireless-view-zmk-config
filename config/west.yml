## config/west.yml
```yaml
manifest:
  remotes:
    - name: zmkfirmware
      url-base: https://github.com/zmkfirmware
    - name: pochoi
      url-base: https://github.com/pochoi
    - name: jyojoh
      url-base: https://github.com/jyojoh
    - name: PraeceptorXS
      url-base: https://github.com/PraeceptorXS
  projects:
    - name: zmk
      remote: pochoi
      revision: staticcat
      import: app/west.yml
  self:
    path: config
```
